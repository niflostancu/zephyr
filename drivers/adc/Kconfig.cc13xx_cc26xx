## drivers/adc/Kconfig.cc13xx_cc26xx
```kconfig
# Copyright (c) 2021 Pavlo Hamov <pasha.gamov@gmail.com>
# SPDX-License-Identifier: Apache-2.0

DT_COMPAT_TI_CC13XX_CC26XX_ADC := ti,cc13xx-cc26xx-adc

config ADC_CC13XX_CC26XX
	bool "CC32XX ADC driver"
	depends on SOC_SERIES_CC13X2_CC26X2 && SOC_FAMILY_TISIMPLELINK
	default $(dt_compat_enabled,$(DT_COMPAT_TI_CC13XX_CC26XX_ADC))
	help
	  This option enables the CC13XX/CC26XX ADC driver.
```

## dts/bindings/adc/ti,cc13xx-cc26xx-adc.yaml
```yaml
# Copyright (c) 2021 Florin Stancu <niflostancu@gmail.com>
# SPDX-License-Identifier: Apache-2.0

description: |
    ADC node for TI CC13XX/CC26xx.

    The MCU's pinmux supports having

compatible: "ti,cc13xx-cc26xx-adc"

include: adc-controller.yaml

properties:
    reg:
      required: true

    interrupts:
      required: true

    "#io-channel-cells":
      const: 1

io-channel-cells:
    - input
```
